## board/freescale/imx8mp_evk_test/Kconfig
```kconfig
if TARGET_IMX8MP_EVK_TEST

config SYS_BOARD
	default "imx8mp_evk_test"

config SYS_VENDOR
	default "freescale"

config SYS_CONFIG_NAME
	default "imx8mp_evk_test"

config IMX_CONFIG
	default "board/freescale/imx8mp_evk_test/imximage-8mp-lpddr4.cfg"

source "board/freescale/common/Kconfig"

endif
```
